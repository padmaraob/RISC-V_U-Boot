## arch/riscv/Kconfig
```kconfig
menu "RISCV architecture"
	depends on RISCV

config SYS_ARCH
	default "riscv"

choice
	prompt "Target select"
	optional

config TARGET_RISCV_M2SXXX
	bool "Support riscv-m2sxxx"

endchoice

source "board/microsemi/riscv-m2sxxx/Kconfig"

endmenu
```

## board/microsemi/riscv-m2sxxx/Kconfig
```kconfig
if TARGET_RISCV_M2SXXX

config SYS_CPU
	default "riscv32"

config SYS_BOARD
	default "riscv-m2sxxx"

config SYS_VENDOR
	default "microsemi"

config SYS_SOC
	default "m2sxxx"

config SYS_CONFIG_NAME
	default "riscv-m2sxxx"

endif
```

## configs/riscv-m2sxxx_defconfig
```kconfig
CONFIG_RISCV=y
CONFIG_TARGET_RISCV_M2SXXX=y
CONFIG_BOOTDELAY=3
CONFIG_SYS_PROMPT="RISC-V # "
# CONFIG_CMD_MMC=n
# CONFIG_CMD_SETEXPR is not set
# CONFIG_CMD_PING=n
# CONFIG_CMD_CACHE=n
# CONFIG_CMD_EXT2=n
# CONFIG_CMD_FAT=n
# CONFIG_SYS_NS16550=y
```
